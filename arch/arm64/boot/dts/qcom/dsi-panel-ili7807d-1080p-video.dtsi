/* Copyright (c) 2015, The Linux Foundation. All rights reserved.
 *
 * This program is free software; you can redistribute it and/or modify
 * it under the terms of the GNU General Public License version 2 and
 * only version 2 as published by the Free Software Foundation.
 *
 * This program is distributed in the hope that it will be useful,
 * but WITHOUT ANY WARRANTY; without even the implied warranty of
 * MERCHANTABILITY or FITNESS FOR A PARTICULAR PURPOSE.  See the
 * GNU General Public License for more details.
 */

/*---------------------------------------------------------------------------
 * This file is autogenerated file using gcdb parser. Please do not edit it.
 * Update input XML file to add a new entry or update variable in this file
 * VERSION = "1.0"
 *---------------------------------------------------------------------------*/
&mdss_mdp {
	dsi_ili7807d_1080p_video: qcom,mdss_dsi_ili7807d_1080p_video {
		qcom,mdss-dsi-panel-name = "ili7807d 1080p video mode dsi panel";
		qcom,mdss-dsi-panel-type = "dsi_video_mode";
		qcom,mdss-dsi-panel-framerate = <60>;
		qcom,mdss-dsi-virtual-channel-id = <0>;
		qcom,mdss-dsi-stream = <0>;
		qcom,mdss-dsi-panel-width = <1080>;
		qcom,mdss-dsi-panel-height = <1920>;
		qcom,mdss-dsi-h-front-porch = <84>;
		qcom,mdss-dsi-h-back-porch = <80>;
		qcom,mdss-dsi-h-pulse-width = <12>;
		qcom,mdss-dsi-h-sync-skew = <0>;
		qcom,mdss-dsi-v-back-porch = <38>;
		qcom,mdss-dsi-v-front-porch = <40>;
		qcom,mdss-dsi-v-pulse-width = <4>;
		qcom,mdss-dsi-h-left-border = <0>;
		qcom,mdss-dsi-h-right-border = <0>;
		qcom,mdss-dsi-v-top-border = <0>;
		qcom,mdss-dsi-v-bottom-border = <0>;
		qcom,mdss-dsi-bpp = <24>;
		qcom,mdss-dsi-underflow-color = <0xff>;
		qcom,mdss-dsi-border-color = <0>;
		qcom,mdss-dsi-on-command = [
			39 01 00 00 00 00 04 FF 78 07 01
			15 01 00 00 00 00 02 42 11
			15 01 00 00 00 00 02 43 A3
			15 01 00 00 00 00 02 44 A8						 
			15 01 00 00 00 00 02 45 19
			15 01 00 00 00 00 02 46 28						
			15 01 00 00 00 00 02 4A 12
			15 01 00 00 00 00 02 4B 12					   
			15 01 00 00 00 00 02 50 5F
			15 01 00 00 00 00 02 51 5F					   
			15 01 00 00 00 00 02 B3 70
			15 01 00 00 00 00 02 B4 70						 
			15 01 00 00 00 00 02 A2 01
			15 01 00 00 00 00 02 A3 16
			15 01 00 00 00 00 02 57 88
			15 01 00 00 00 00 02 59 35
			15 01 00 00 00 00 02 5A 66
			15 01 00 00 00 00 02 22 06
			15 01 00 00 00 00 02 36 00
			15 01 00 00 00 00 02 63 04
			15 01 00 00 00 00 02 64 08
			15 01 00 00 00 00 02 6C 45
			15 01 00 00 00 00 02 6D 00
			39 01 00 00 00 00 04 FF 78 07 07  
			15 01 00 00 00 00 02 CA 63  
			39 01 00 00 00 00 04 FF 78 07 06
			15 01 00 00 00 00 02 00 43
			15 01 00 00 00 00 02 01 12
			15 01 00 00 00 00 02 02 43
			15 01 00 00 00 00 02 03 43 
			15 01 00 00 00 00 02 04 03
			15 01 00 00 00 00 02 05 12
			15 01 00 00 00 00 02 06 08
			15 01 00 00 00 00 02 07 0A 
			15 01 00 00 00 00 02 08 83
			15 01 00 00 00 00 02 09 02
			15 01 00 00 00 00 02 0A 30
			15 01 00 00 00 00 02 0B 10
			15 01 00 00 00 00 02 0C 08
			15 01 00 00 00 00 02 0D 08
			15 01 00 00 00 00 02 0E 00
			15 01 00 00 00 00 02 0F 00
			15 01 00 00 00 00 02 10 00
			15 01 00 00 00 00 02 11 00
			15 01 00 00 00 00 02 12 00
			15 01 00 00 00 00 02 13 00
			15 01 00 00 00 00 02 14 84
			15 01 00 00 00 00 02 15 84						
			15 01 00 00 00 00 02 31 08
			15 01 00 00 00 00 02 32 01
			15 01 00 00 00 00 02 33 00
			15 01 00 00 00 00 02 34 11
			15 01 00 00 00 00 02 35 13
			15 01 00 00 00 00 02 36 26
			15 01 00 00 00 00 02 37 22
			15 01 00 00 00 00 02 38 02
			15 01 00 00 00 00 02 39 0C
			15 01 00 00 00 00 02 3A 02
			15 01 00 00 00 00 02 3B 02
			15 01 00 00 00 00 02 3C 02
			15 01 00 00 00 00 02 3D 02
			15 01 00 00 00 00 02 3E 28
			15 01 00 00 00 00 02 3F 29
			15 01 00 00 00 00 02 40 2A					   
			15 01 00 00 00 00 02 41 08
			15 01 00 00 00 00 02 42 01
			15 01 00 00 00 00 02 43 00
			15 01 00 00 00 00 02 44 10
			15 01 00 00 00 00 02 45 12
			15 01 00 00 00 00 02 46 26
			15 01 00 00 00 00 02 47 22
			15 01 00 00 00 00 02 48 02
			15 01 00 00 00 00 02 49 0C
			15 01 00 00 00 00 02 4A 02
			15 01 00 00 00 00 02 4B 02
			15 01 00 00 00 00 02 4C 02
			15 01 00 00 00 00 02 4D 02
			15 01 00 00 00 00 02 4E 28
			15 01 00 00 00 00 02 4F 29
			15 01 00 00 00 00 02 50 2A						 
			15 01 00 00 00 00 02 61 0C
			15 01 00 00 00 00 02 62 01
			15 01 00 00 00 00 02 63 00
			15 01 00 00 00 00 02 64 12
			15 01 00 00 00 00 02 65 10
			15 01 00 00 00 00 02 66 26
			15 01 00 00 00 00 02 67 22
			15 01 00 00 00 00 02 68 02
			15 01 00 00 00 00 02 69 08
			15 01 00 00 00 00 02 6A 02
			15 01 00 00 00 00 02 6B 02
			15 01 00 00 00 00 02 6C 02
			15 01 00 00 00 00 02 6D 02
			15 01 00 00 00 00 02 6E 28
			15 01 00 00 00 00 02 6F 29
			15 01 00 00 00 00 02 70 2A						 
			15 01 00 00 00 00 02 71 0C
			15 01 00 00 00 00 02 72 01
			15 01 00 00 00 00 02 73 00
			15 01 00 00 00 00 02 74 13
			15 01 00 00 00 00 02 75 11
			15 01 00 00 00 00 02 76 26
			15 01 00 00 00 00 02 77 22
			15 01 00 00 00 00 02 78 02
			15 01 00 00 00 00 02 79 08
			15 01 00 00 00 00 02 7A 02
			15 01 00 00 00 00 02 7B 02
			15 01 00 00 00 00 02 7C 02
			15 01 00 00 00 00 02 7D 02
			15 01 00 00 00 00 02 7E 28
			15 01 00 00 00 00 02 7F 29
			15 01 00 00 00 00 02 80 2A						
			15 01 00 00 00 00 02 D0 01
			15 01 00 00 00 00 02 D1 01
			15 01 00 00 00 00 02 D2 10
			15 01 00 00 00 00 02 D3 00
			15 01 00 00 00 00 02 D4 00
			15 01 00 00 00 00 02 D5 00
			15 01 00 00 00 00 02 D6 00
			15 01 00 00 00 00 02 D7 00
			15 01 00 00 00 00 02 D8 00
			15 01 00 00 00 00 02 D9 00
			15 01 00 00 00 00 02 DA 00
			15 01 00 00 00 00 02 DB 47
			15 01 00 00 00 00 02 DC 02
			15 01 00 00 00 00 02 DD 55					 
			15 01 00 00 00 00 02 96 80
			15 01 00 00 00 00 02 97 33						 
			15 01 00 00 00 00 02 A0 10
			15 01 00 00 00 00 02 A1 00
			15 01 00 00 00 00 02 A2 08
			15 01 00 00 00 00 02 A3 1E
			15 01 00 00 00 00 02 A7 00
			15 01 00 00 00 00 02 A6 32
			15 01 00 00 00 00 02 A7 03
			15 01 00 00 00 00 02 AE 14						 
			15 01 00 00 00 00 02 E5 80
			15 01 00 00 00 00 02 B2 04
			15 01 00 00 00 00 02 B3 04	
			39 01 00 00 00 00 04 FF 78 07 02			
			15 01 00 00 00 00 02 00 00
			15 01 00 00 00 00 02 01 9F
			15 01 00 00 00 00 02 02 00
			15 01 00 00 00 00 02 03 AF
			15 01 00 00 00 00 02 04 00
			15 01 00 00 00 00 02 05 C6
			15 01 00 00 00 00 02 06 00
			15 01 00 00 00 00 02 07 DC
			15 01 00 00 00 00 02 08 00
			15 01 00 00 00 00 02 09 EF
			15 01 00 00 00 00 02 0A 00
			15 01 00 00 00 00 02 0B FE
			15 01 00 00 00 00 02 0C 01
			15 01 00 00 00 00 02 0D 0F
			15 01 00 00 00 00 02 0E 01
			15 01 00 00 00 00 02 0F 1D
			15 01 00 00 00 00 02 10 01
			15 01 00 00 00 00 02 11 28
			15 01 00 00 00 00 02 12 01
			15 01 00 00 00 00 02 13 53
			15 01 00 00 00 00 02 14 01
			15 01 00 00 00 00 02 15 73
			15 01 00 00 00 00 02 16 01
			15 01 00 00 00 00 02 17 A6
			15 01 00 00 00 00 02 18 01
			15 01 00 00 00 00 02 19 CC
			15 01 00 00 00 00 02 1A 02
			15 01 00 00 00 00 02 1B 05
			15 01 00 00 00 00 02 1C 02
			15 01 00 00 00 00 02 1D 32
			15 01 00 00 00 00 02 1E 02
			15 01 00 00 00 00 02 1F 33
			15 01 00 00 00 00 02 20 02
			15 01 00 00 00 00 02 21 5F
			15 01 00 00 00 00 02 22 02
			15 01 00 00 00 00 02 23 96
			15 01 00 00 00 00 02 24 02
			15 01 00 00 00 00 02 25 BC
			15 01 00 00 00 00 02 26 02
			15 01 00 00 00 00 02 27 F1
			15 01 00 00 00 00 02 28 03
			15 01 00 00 00 00 02 29 14
			15 01 00 00 00 00 02 2A 03
			15 01 00 00 00 00 02 2B 40
			15 01 00 00 00 00 02 2C 03
			15 01 00 00 00 00 02 2D 4C
			15 01 00 00 00 00 02 2E 03
			15 01 00 00 00 00 02 2F 5B
			15 01 00 00 00 00 02 30 03
			15 01 00 00 00 00 02 31 6C
			15 01 00 00 00 00 02 32 03
			15 01 00 00 00 00 02 33 7F
			15 01 00 00 00 00 02 34 03
			15 01 00 00 00 00 02 35 96
			15 01 00 00 00 00 02 36 03
			15 01 00 00 00 00 02 37 B4
			15 01 00 00 00 00 02 38 03
			15 01 00 00 00 00 02 39 D5
			15 01 00 00 00 00 02 3A 03
			15 01 00 00 00 00 02 3B E6					  
			15 01 00 00 00 00 02 3C 00
			15 01 00 00 00 00 02 3D 9F
			15 01 00 00 00 00 02 3E 00	
			15 01 00 00 00 00 02 3F AF	
			15 01 00 00 00 00 02 40 00	
			15 01 00 00 00 00 02 41 C6	
			15 01 00 00 00 00 02 42 00	
			15 01 00 00 00 00 02 43 DC	
			15 01 00 00 00 00 02 44 00	
			15 01 00 00 00 00 02 45 EF	
			15 01 00 00 00 00 02 46 00	
			15 01 00 00 00 00 02 47 FE	
			15 01 00 00 00 00 02 48 01	
			15 01 00 00 00 00 02 49 0F	
			15 01 00 00 00 00 02 4A 01	
			15 01 00 00 00 00 02 4B 1D	
			15 01 00 00 00 00 02 4C 01	
			15 01 00 00 00 00 02 4D 28	
			15 01 00 00 00 00 02 4E 01	
			15 01 00 00 00 00 02 4F 53	
			15 01 00 00 00 00 02 50 01	
			15 01 00 00 00 00 02 51 73	
			15 01 00 00 00 00 02 52 01	
			15 01 00 00 00 00 02 53 A6	
			15 01 00 00 00 00 02 54 01	
			15 01 00 00 00 00 02 55 CC	
			15 01 00 00 00 00 02 56 02	
			15 01 00 00 00 00 02 57 05	
			15 01 00 00 00 00 02 58 02			
			15 01 00 00 00 00 02 59 32			
			15 01 00 00 00 00 02 5A 02			
			15 01 00 00 00 00 02 5B 33			
			15 01 00 00 00 00 02 5C 02			
			15 01 00 00 00 00 02 5D 5F			
			15 01 00 00 00 00 02 5E 02			
			15 01 00 00 00 00 02 5F 96			
			15 01 00 00 00 00 02 60 02			
			15 01 00 00 00 00 02 61 BC			
			15 01 00 00 00 00 02 62 02			
			15 01 00 00 00 00 02 63 F1			
			15 01 00 00 00 00 02 64 03			
			15 01 00 00 00 00 02 65 14			
			15 01 00 00 00 00 02 66 03			
			15 01 00 00 00 00 02 67 40			
			15 01 00 00 00 00 02 68 03			
			15 01 00 00 00 00 02 69 4C			
			15 01 00 00 00 00 02 6A 03			
			15 01 00 00 00 00 02 6B 5B			
			15 01 00 00 00 00 02 6C 03			
			15 01 00 00 00 00 02 6D 6C			
			15 01 00 00 00 00 02 6E 03			
			15 01 00 00 00 00 02 6F 7F			
			15 01 00 00 00 00 02 70 03			
			15 01 00 00 00 00 02 71 96			
			15 01 00 00 00 00 02 72 03			
			15 01 00 00 00 00 02 73 B4			
			15 01 00 00 00 00 02 74 03			
			15 01 00 00 00 00 02 75 D5			
			15 01 00 00 00 00 02 76 03			
			15 01 00 00 00 00 02 77 E6								
			15 01 00 00 00 00 02 78 01			
			15 01 00 00 00 00 02 79 01			
			39 01 00 00 00 00 04 FF 78 07 03			
			15 01 00 00 00 00 02 00 00			
			15 01 00 00 00 00 02 01 F2			
			15 01 00 00 00 00 02 02 00	
			15 01 00 00 00 00 02 03 FA	
			15 01 00 00 00 00 02 04 01	
			15 01 00 00 00 00 02 05 0B	
			15 01 00 00 00 00 02 06 01	
			15 01 00 00 00 00 02 07 18	
			15 01 00 00 00 00 02 08 01	
			15 01 00 00 00 00 02 09 26	
			15 01 00 00 00 00 02 0A 01	
			15 01 00 00 00 00 02 0B 33	
			15 01 00 00 00 00 02 0C 01	
			15 01 00 00 00 00 02 0D 3D	
			15 01 00 00 00 00 02 0E 01	
			15 01 00 00 00 00 02 0F 48	
			15 01 00 00 00 00 02 10 01	
			15 01 00 00 00 00 02 11 51	
			15 01 00 00 00 00 02 12 01	
			15 01 00 00 00 00 02 13 72	
			15 01 00 00 00 00 02 14 01	
			15 01 00 00 00 00 02 15 8E	
			15 01 00 00 00 00 02 16 01	
			15 01 00 00 00 00 02 17 B9	
			15 01 00 00 00 00 02 18 01	
			15 01 00 00 00 00 02 19 DB	
			15 01 00 00 00 00 02 1A 02	
			15 01 00 00 00 00 02 1B 0F	
			15 01 00 00 00 00 02 1C 02			
			15 01 00 00 00 00 02 1D 3A			
			15 01 00 00 00 00 02 1E 02			
			15 01 00 00 00 00 02 1F 3B			
			15 01 00 00 00 00 02 20 02			
			15 01 00 00 00 00 02 21 66			
			15 01 00 00 00 00 02 22 02			
			15 01 00 00 00 00 02 23 9C			
			15 01 00 00 00 00 02 24 02			
			15 01 00 00 00 00 02 25 C2			
			15 01 00 00 00 00 02 26 02			
			15 01 00 00 00 00 02 27 F6			
			15 01 00 00 00 00 02 28 03			
			15 01 00 00 00 00 02 29 19			
			15 01 00 00 00 00 02 2A 03			
			15 01 00 00 00 00 02 2B 44			
			15 01 00 00 00 00 02 2C 03			
			15 01 00 00 00 00 02 2D 52			
			15 01 00 00 00 00 02 2E 03			
			15 01 00 00 00 00 02 2F 60			
			15 01 00 00 00 00 02 30 03			
			15 01 00 00 00 00 02 31 70			
			15 01 00 00 00 00 02 32 03			
			15 01 00 00 00 00 02 33 83			
			15 01 00 00 00 00 02 34 03			
			15 01 00 00 00 00 02 35 97			
			15 01 00 00 00 00 02 36 03			
			15 01 00 00 00 00 02 37 B4			
			15 01 00 00 00 00 02 38 03			
			15 01 00 00 00 00 02 39 D5			
			15 01 00 00 00 00 02 3A 03			
			15 01 00 00 00 00 02 3B E6									 
			15 01 00 00 00 00 02 3C 00			
			15 01 00 00 00 00 02 3D F2			
			15 01 00 00 00 00 02 3E 00	
			15 01 00 00 00 00 02 3F FA	
			15 01 00 00 00 00 02 40 01	
			15 01 00 00 00 00 02 41 0B	
			15 01 00 00 00 00 02 42 01	
			15 01 00 00 00 00 02 43 18	
			15 01 00 00 00 00 02 44 01	
			15 01 00 00 00 00 02 45 26	
			15 01 00 00 00 00 02 46 01	
			15 01 00 00 00 00 02 47 33	
			15 01 00 00 00 00 02 48 01	
			15 01 00 00 00 00 02 49 3D	
			15 01 00 00 00 00 02 4A 01	
			15 01 00 00 00 00 02 4B 48	
			15 01 00 00 00 00 02 4C 01	
			15 01 00 00 00 00 02 4D 51	
			15 01 00 00 00 00 02 4E 01	
			15 01 00 00 00 00 02 4F 72	
			15 01 00 00 00 00 02 50 01	
			15 01 00 00 00 00 02 51 8E	
			15 01 00 00 00 00 02 52 01	
			15 01 00 00 00 00 02 53 B9	
			15 01 00 00 00 00 02 54 01	
			15 01 00 00 00 00 02 55 DB	
			15 01 00 00 00 00 02 56 02	
			15 01 00 00 00 00 02 57 0F	
			15 01 00 00 00 00 02 58 02			
			15 01 00 00 00 00 02 59 3A			
			15 01 00 00 00 00 02 5A 02			
			15 01 00 00 00 00 02 5B 3B			
			15 01 00 00 00 00 02 5C 02			
			15 01 00 00 00 00 02 5D 66			
			15 01 00 00 00 00 02 5E 02			
			15 01 00 00 00 00 02 5F 9C			
			15 01 00 00 00 00 02 60 02			
			15 01 00 00 00 00 02 61 C2			
			15 01 00 00 00 00 02 62 02			
			15 01 00 00 00 00 02 63 F6			
			15 01 00 00 00 00 02 64 03			
			15 01 00 00 00 00 02 65 19			
			15 01 00 00 00 00 02 66 03			
			15 01 00 00 00 00 02 67 44			
			15 01 00 00 00 00 02 68 03			
			15 01 00 00 00 00 02 69 52			
			15 01 00 00 00 00 02 6A 03			
			15 01 00 00 00 00 02 6B 60			
			15 01 00 00 00 00 02 6C 03			
			15 01 00 00 00 00 02 6D 70			
			15 01 00 00 00 00 02 6E 03			
			15 01 00 00 00 00 02 6F 83			
			15 01 00 00 00 00 02 70 03			
			15 01 00 00 00 00 02 71 97			
			15 01 00 00 00 00 02 72 03			
			15 01 00 00 00 00 02 73 B4			
			15 01 00 00 00 00 02 74 03			
			15 01 00 00 00 00 02 75 D5			
			15 01 00 00 00 00 02 76 03			
			15 01 00 00 00 00 02 77 E6								 
			15 01 00 00 00 00 02 78 01			
			15 01 00 00 00 00 02 79 01						
			39 01 00 00 00 00 04 FF 78 07 04			
			15 01 00 00 00 00 02 00 01			
			15 01 00 00 00 00 02 01 06			
			15 01 00 00 00 00 02 02 01	
			15 01 00 00 00 00 02 03 0E	
			15 01 00 00 00 00 02 04 01	
			15 01 00 00 00 00 02 05 1C	
			15 01 00 00 00 00 02 06 01	
			15 01 00 00 00 00 02 07 29	
			15 01 00 00 00 00 02 08 01	
			15 01 00 00 00 00 02 09 36	
			15 01 00 00 00 00 02 0A 01	
			15 01 00 00 00 00 02 0B 41	
			15 01 00 00 00 00 02 0C 01	
			15 01 00 00 00 00 02 0D 4C	
			15 01 00 00 00 00 02 0E 01	
			15 01 00 00 00 00 02 0F 55	
			15 01 00 00 00 00 02 10 01	
			15 01 00 00 00 00 02 11 5E	
			15 01 00 00 00 00 02 12 01	
			15 01 00 00 00 00 02 13 7E	
			15 01 00 00 00 00 02 14 01	
			15 01 00 00 00 00 02 15 97	
			15 01 00 00 00 00 02 16 01	
			15 01 00 00 00 00 02 17 C0	
			15 01 00 00 00 00 02 18 01	
			15 01 00 00 00 00 02 19 E0	
			15 01 00 00 00 00 02 1A 02	
			15 01 00 00 00 00 02 1B 12	
			15 01 00 00 00 00 02 1C 02			
			15 01 00 00 00 00 02 1D 3C			
			15 01 00 00 00 00 02 1E 02			
			15 01 00 00 00 00 02 1F 3D			
			15 01 00 00 00 00 02 20 02			
			15 01 00 00 00 00 02 21 67			
			15 01 00 00 00 00 02 22 02			
			15 01 00 00 00 00 02 23 9D			
			15 01 00 00 00 00 02 24 02			
			15 01 00 00 00 00 02 25 C3			
			15 01 00 00 00 00 02 26 02			
			15 01 00 00 00 00 02 27 F9			
			15 01 00 00 00 00 02 28 03			
			15 01 00 00 00 00 02 29 1E			
			15 01 00 00 00 00 02 2A 03			
			15 01 00 00 00 00 02 2B 51			
			15 01 00 00 00 00 02 2C 03			
			15 01 00 00 00 00 02 2D 63			
			15 01 00 00 00 00 02 2E 03			
			15 01 00 00 00 00 02 2F 70			
			15 01 00 00 00 00 02 30 03			
			15 01 00 00 00 00 02 31 7F			
			15 01 00 00 00 00 02 32 03			
			15 01 00 00 00 00 02 33 8F			
			15 01 00 00 00 00 02 34 03			
			15 01 00 00 00 00 02 35 A2			
			15 01 00 00 00 00 02 36 03			
			15 01 00 00 00 00 02 37 BD			
			15 01 00 00 00 00 02 38 03			
			15 01 00 00 00 00 02 39 D8			
			15 01 00 00 00 00 02 3A 03			
			15 01 00 00 00 00 02 3B E6					   
			15 01 00 00 00 00 02 3C 01			
			15 01 00 00 00 00 02 3D 06			
			15 01 00 00 00 00 02 3E 01	
			15 01 00 00 00 00 02 3F 0E	
			15 01 00 00 00 00 02 40 01	
			15 01 00 00 00 00 02 41 1C	
			15 01 00 00 00 00 02 42 01	
			15 01 00 00 00 00 02 43 29	
			15 01 00 00 00 00 02 44 01	
			15 01 00 00 00 00 02 45 36	
			15 01 00 00 00 00 02 46 01	
			15 01 00 00 00 00 02 47 41	
			15 01 00 00 00 00 02 48 01	
			15 01 00 00 00 00 02 49 4C	
			15 01 00 00 00 00 02 4A 01	
			15 01 00 00 00 00 02 4B 55	
			15 01 00 00 00 00 02 4C 01	
			15 01 00 00 00 00 02 4D 5E	
			15 01 00 00 00 00 02 4E 01	
			15 01 00 00 00 00 02 4F 7E	
			15 01 00 00 00 00 02 50 01	
			15 01 00 00 00 00 02 51 97	
			15 01 00 00 00 00 02 52 01	
			15 01 00 00 00 00 02 53 C0	
			15 01 00 00 00 00 02 54 01	
			15 01 00 00 00 00 02 55 E0	
			15 01 00 00 00 00 02 56 02	
			15 01 00 00 00 00 02 57 12	
			15 01 00 00 00 00 02 58 02			
			15 01 00 00 00 00 02 59 3C			
			15 01 00 00 00 00 02 5A 02			
			15 01 00 00 00 00 02 5B 3D			
			15 01 00 00 00 00 02 5C 02			
			15 01 00 00 00 00 02 5D 67			
			15 01 00 00 00 00 02 5E 02			
			15 01 00 00 00 00 02 5F 9D			
			15 01 00 00 00 00 02 60 02			
			15 01 00 00 00 00 02 61 C3			
			15 01 00 00 00 00 02 62 02			
			15 01 00 00 00 00 02 63 F9			
			15 01 00 00 00 00 02 64 03			
			15 01 00 00 00 00 02 65 1E			
			15 01 00 00 00 00 02 66 03			
			15 01 00 00 00 00 02 67 51			
			15 01 00 00 00 00 02 68 03			
			15 01 00 00 00 00 02 69 63			
			15 01 00 00 00 00 02 6A 03			
			15 01 00 00 00 00 02 6B 70			
			15 01 00 00 00 00 02 6C 03			
			15 01 00 00 00 00 02 6D 7F			
			15 01 00 00 00 00 02 6E 03			
			15 01 00 00 00 00 02 6F 8F			
			15 01 00 00 00 00 02 70 03			
			15 01 00 00 00 00 02 71 A2			
			15 01 00 00 00 00 02 72 03			
			15 01 00 00 00 00 02 73 BD			
			15 01 00 00 00 00 02 74 03			
			15 01 00 00 00 00 02 75 D8			
			15 01 00 00 00 00 02 76 03			
			15 01 00 00 00 00 02 77 E6					   
			15 01 00 00 00 00 02 78 01			
			15 01 00 00 00 00 02 79 01
			39 01 00 00 00 00 04 FF 78 07 00
			15 01 00 00 00 00 02 35 00
			15 01 00 00 00 00 03 51 00 50
			39 01 00 00 14 00 02 53 24
			05 01 00 00 ff 00 01 11
			05 01 00 00 ff 00 01 29];
		qcom,mdss-dsi-off-command = [05 01 00 00 78 00 02 28 00
			05 01 00 00 96 00 02 10 00];
		qcom,mdss-dsi-on-command-state = "dsi_lp_mode";
		qcom,mdss-dsi-off-command-state = "dsi_hs_mode";
		qcom,mdss-pan-physical-width-dimension = <65>;
		qcom,mdss-pan-physical-height-dimension = <129>;
		qcom,mdss-dsi-h-sync-pulse = <1>;
		qcom,mdss-dsi-traffic-mode = "non_burst_sync_pulse";
		qcom,mdss-dsi-bllp-eof-power-mode;
		qcom,mdss-dsi-bllp-power-mode;
		qcom,mdss-dsi-lane-0-state;
		qcom,mdss-dsi-lane-1-state;
		qcom,mdss-dsi-lane-2-state;
		qcom,mdss-dsi-lane-3-state;
		qcom,mdss-dsi-panel-timings = [7d 25 1d 00 37 33
			22 27 1e 03 04 00];
		qcom,mdss-dsi-t-clk-post = <0x2>;
		qcom,mdss-dsi-t-clk-pre = <0x26>;
		qcom,mdss-dsi-bl-min-level = <1>;
		qcom,mdss-dsi-bl-max-level = <4095>;
		qcom,mdss-dsi-dma-trigger = "trigger_sw";
		qcom,mdss-dsi-mdp-trigger = "none";
		qcom,mdss-dsi-bl-pmic-control-type = "bl_ctrl_wled";
		qcom,mdss-dsi-reset-sequence = <1 10>, <0 50>, <1 120>;
	};
};
